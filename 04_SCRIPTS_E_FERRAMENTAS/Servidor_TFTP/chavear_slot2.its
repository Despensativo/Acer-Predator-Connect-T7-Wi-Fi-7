## 04_SCRIPTS_E_FERRAMENTAS/Servidor_TFTP/chavear_slot2.its
```
/dts-v1/;

/ {
    description = "Flash Chavear Slot 2";
    #address-cells = <1>;

    images {
        script {
            description = "Chavear para Slot 2 Script";
            data = /incbin/("script_slot2.txt");
            type = "script";
            compression = "none";
            hash-1 {
                algo = "crc32";
            };
        };
        bootconfig {
            description = "Bootconfig Payload";
            data = /incbin/("bootconfig.bin");
            type = "firmware";
            compression = "none";
            hash-1 {
                algo = "crc32";
            };
        };
        padding {
            description = "Padding for minimum size";
            data = /incbin/("padding.bin");
            type = "ramdisk";
            compression = "none";
            hash-1 {
                algo = "crc32";
            };
        };
    };

    configurations {
        default = "config-1";
        config-1 {
            description = "Chavear Slot 2";
        };
    };
};
```

## 07_ARTEFATOS_BUILD_WSL/artefatos/sonda-uboot-rede-30fa04acf23b48a7a705e5455ae728a0/sonda.its
```
/dts-v1/;
/ {
 description = "Flash T7 network probe";
 #address-cells = <1>;
 images { script {
  description = "Read upload buffer; no kernel boot or persistent commands";
  data = /incbin/("script.txt");
  type = "script"; arch = "arm"; os = "linux"; compression = "none";
  hash@1 { algo = "crc32"; };
 }; };
};
```

## 07_ARTEFATOS_BUILD_WSL/artefatos/t7-diag-20261002-v1/candidato.its
```
/dts-v1/;
/ {
    description = "T7 diagnostic candidate - NOT FOR HTTP FAILSAFE UPLOAD";
    #address-cells = <1>;
    images {
        kernel@1 {
            description = "New ARM64 kernel with minimal embedded initramfs";
            data = /incbin/("Image.lzma");
            type = "kernel"; arch = "arm64"; os = "linux";
            compression = "lzma";
            load = <0x41000000>; entry = <0x41000000>;
            hash@1 { algo = "crc32"; };
        };
        fdt@1 {
            description = "T7 conservative diagnostic DTB candidate";
            data = /incbin/("t7-diagnostico.dtb");
            type = "flat_dt"; arch = "arm64"; compression = "none";
            hash@1 { algo = "crc32"; };
        };
    };
    configurations {
        default = "config@mi01.6";
        config@mi01.6 { kernel = "kernel@1"; fdt = "fdt@1"; };
    };
};
```
